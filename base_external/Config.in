## base_external/Config.in
```kconfig
source "$/home/rishi54/aesd/final-project-Rishikesh38/base_external/package/application-code/Config.in"
```

## base_external/package/application-code/Config.in
```kconfig
config BR2_PACKAGE_APPLICATION_CODE
	bool "application-code"
	help
	  Includes the server with camera drivers and client application in the kernel image.
	  Used to understand buildroot external trees and package builds.
```
